## sdkconfig.defaults
```kconfig
# Target
CONFIG_IDF_TARGET_ESP32S3=y


# Logging (optional)
CONFIG_LOG_DEFAULT_LEVEL_INFO=y

# Power Management (optional für DFS)
CONFIG_PM_ENABLE=y
CONFIG_FREERTOS_USE_TICKLESS_IDLE=y

# WLAN Buffers konservativ
CONFIG_ESP_WIFI_STATIC_RX_BUFFER_NUM=4
CONFIG_ESP_WIFI_DYNAMIC_RX_BUFFER_NUM=8
CONFIG_ESP_WIFI_TX_BUFFER_TYPE=1
```
